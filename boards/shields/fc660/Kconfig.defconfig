## boards/shields/fc660/Kconfig.defconfig
```kconfig
if SHIELD_FC660

# Name must be less than 16 characters long!
config ZMK_KEYBOARD_FC660
    default "fc660"

endif
```

## boards/shields/fc660/Kconfig.shield
```kconfig
# No whitespace after the comma or in your keyboard name!
config SHIELD_FC660
    def_bool $(shields_list_contains,fc660)
```

## config/boards/shields/fc660/Kconfig.defconfig
```kconfig
if SHIELD_FC660

# Name must be less than 16 characters long!
config ZMK_KEYBOARD_NAME
    default "fc660"

endif
```
